## board/variscite/imx8mp_var_dart/Kconfig
```kconfig
if TARGET_IMX8MP_VAR_DART

config SYS_BOARD
	default "imx8mp_var_dart"

config SYS_VENDOR
	default "variscite"

config SYS_CONFIG_NAME
	default "imx8mp_var_dart"

choice
	prompt "FireFLY CP board variant"
	optional
	help
	  Select the FireFLY Comprehensive Platform variant. This sets the
	  default carrier_name, so findfdt picks
	  imx8mp-var-dart[-1.x|-wbe]-firefly-cp-<variant>.dtb from the SOM
	  EEPROM revision. The CP has no Variscite carrier EEPROM.

config FFCP_VARIANT_AO
	bool "FireFLY CP AO"

config FFCP_VARIANT_LE
	bool "FireFLY CP LE"

endchoice

endif
```
